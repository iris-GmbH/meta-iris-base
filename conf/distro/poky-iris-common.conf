## conf/distro/poky-iris-common.conf
```bitbake
# SPDX-License-Identifier: MIT
# Copyright (C) 2021 iris-GmbH infrared & intelligent sensors

require conf/distro/poky.conf

DISTRO_NAME = "IRIS IRMA"
DISTRO_VERSION = "${IRMA_DISTRO_VERSION}"
unset DISTRO_CODENAME

# map IRIS_PRODUCT (set by kas to "irma6r1", "irma6r2" or "irma-matrix") to DISTROOVERRIDES
IRIS_PRODUCT ?= "none"
IRMA_HW_PLATFORM := "${@\
    '0601' if d.getVar('IRIS_PRODUCT', False) == 'irma6r1' else \
    '0602' if d.getVar('IRIS_PRODUCT', False) == 'irma6r2' else \
    '0501' if d.getVar('IRIS_PRODUCT', False) == 'matrix' else \
    '0000' \
}"
DISTROOVERRIDES .= ":poky-iris-${IRMA_HW_PLATFORM}"

# enable mdev
VIRTUAL-RUNTIME_dev_manager = "busybox-mdev"
VIRTUAL-RUNTIME_login_manager = "busybox"
VIRTUAL-RUNTIME_initscripts = "initscripts"
VIRTUAL-RUNTIME_keymaps = "keymaps"

# we only want to cherry-pick u-boot and kernel recipes from the adi upstream. ignore everything else
BBMASK += "meta-adi-adsp-sc5xx\/(?!(recipes-bsp\/u-boot)|(recipes-kernel\/linux)|(recipes-kernel\/linux-firmware)).+\/.+"
# mask cst-native_3.1.0, which will cause warnings due to non-existent binary
BBMASK += "meta-secure-imx/recipes-support/cst/cst-native_3.1.0.bb"

PACKAGE_CLASSES ?= "package_ipk"

# Set deploy dir for raw packages to tmpdir as we don't need them; reduces artifact size in gitlab CI
DEPLOY_DIR_IPK = "${TMPDIR}/ipk-deploy"
DEPLOY_DIR_RPM = "${TMPDIR}/rpm-deploy"
DEPLOY_DIR_DEB = "${TMPDIR}/deb-deploy"

USER_CLASSES ?= "buildstats"

PACKAGECONFIG:append:pn-qemu-native = " sdl"
PACKAGECONFIG:append:pn-nativesdk-qemu = " sdl"

# develop hab dir path will be overwritten during release
HAB_DIR ?= "${KAS_WORK_DIR}/meta-iris-base/dev_keys/hab"
HAB_DIR:mx93-nxp-bsp = "${KAS_WORK_DIR}/meta-iris-base/dev_keys/ahab"

SRKTAB ?= "${HAB_DIR}/crts/SRK_1_2_3_4_table.bin"
CSFK ?= "${HAB_DIR}/crts/CSF1_1_sha256_secp521r1_v3_usr_crt.pem"
SIGN_CERT ?= "${HAB_DIR}/crts/IMG1_1_sha256_secp521r1_v3_usr_crt.pem"
CRYPTO_HW_ACCEL ?= "CAAM"
BBMASK += "meta-secure-imx/recipes-bsp/u-boot/u-boot_%.bbappend"

# swupdate signing
SWUPDATE_DIR ?= "${KAS_WORK_DIR}/meta-iris-base/dev_keys/swupdate"
SWUPDATE_SIGNING ?= "CMS"
# develop keys will be overwritten during release
SWUPDATE_CA_CERT ?= "${SWUPDATE_DIR}/swupdate_snakeoil_ca.crt"
SWUPDATE_CMS_CERT ?= "${SWUPDATE_DIR}/swupdate_snakeoil.crt"
SWUPDATE_CMS_KEY ?= "${SWUPDATE_DIR}/swupdate_snakeoil.key"

# swupdate encryption
# used for signing the swupdate package
SWUPDATE_AES_FILE ?= "${SWUPDATE_DIR}/swupdate_snakeoil_encryption.key"
# used for adding the snakeoil key to rootfs via uuu
SWUPDATE_AES_SNAKEOIL_FILE ?= "${SWUPDATE_DIR}/swupdate_snakeoil_encryption.key"

# roothash signature key for the read only rootfs
SIGNING_KEYS_DIR ?= "${KAS_WORK_DIR}/meta-iris-base/dev_keys/signing"
ROOTHASH_SIGNING_PRIVATE_KEY ?= "${SIGNING_KEYS_DIR}/roothash-private-key.pem"
ROOTHASH_SIGNING_PUBLIC_KEY ?= "${SIGNING_KEYS_DIR}/roothash-public-key.pem"
ROOTHASH_DM_VERITY_SALT ?= "${SIGNING_KEYS_DIR}/roothash.salt"

# identity key and cert used for adding the snakeoil key to rootfs via uuu
IDENTITY_KEY_DIR ?= "${KAS_WORK_DIR}/meta-iris-base/dev_keys/identity"
IDENTITY_SNAKEOIL_KEY ?= "${IDENTITY_KEY_DIR}/sensor_identity_snakeoil.key"
IDENTITY_SNAKEOIL_CRT ?= "${IDENTITY_KEY_DIR}/sensor_identity_snakeoil.crt"

# certificate for encrypting the download archiv
DOWNLOAD_KEY_DIR ?= "${KAS_WORK_DIR}/meta-iris-base/dev_keys/download"
DOWNLOAD_CRT ?= "${DOWNLOAD_KEY_DIR}/download_snakeoil.crt"

IMAGE_FEATURES += "read-only-rootfs"
IMAGE_FEATURES:remove:poky-iris-0601 = "read-only-rootfs"
# force removal of user management tools
# since ROOTFS_POSTUNINSTALL_COMMAND does not actively uninstall them
FORCE_RO_REMOVE:poky-iris-0601 = "1"

# libgfortran throws an error because gcc is built without fortran support
# the following line (taken from poky/meta-poky/conf/local.conf.sample.extended)
# mutes the error
FORTRAN:forcevariable = ",fortran"

# mongoose is also provided by suitesparse. But we want the "real" mongoose recipe
PREFERRED_PROVIDER_mongoose = "mongoose"

# Multiple providers are available ... (libdevmapper-native, lvm2-native)
PREFERRED_RPROVIDER_libdevmapper-native = "libdevmapper-native"

# overwrite default distro features
DISTRO_FEATURES = "nfs ipv4 ipv6 multiarch"

# remove default backfilled features
DISTRO_FEATURES_BACKFILL_CONSIDERED = "pulseaudio gobject-introspection-data"
# ldconfig is used to rebuild the /etc/ld.so.cache when new libraries are introduced during runtime
# this is not needed and /etc/ld.so.cache is already populated by Yocto, disabling this saves ~250kB
DISTRO_FEATURES_BACKFILL_CONSIDERED:append:poky-iris-0601 =" ldconfig"

# Disable rtc in busybox
MACHINE_FEATURES_BACKFILL_CONSIDERED:poky-iris-0601 = "rtc"
```

## conf/distro/poky-iris-maintenance.conf
```bitbake
# SPDX-License-Identifier: MIT
# Copyright (C) 2022 iris-GmbH infrared & intelligent sensors

require conf/distro/poky-iris-common.conf

DISTRO = "poky-iris-maintenance"
```

## conf/distro/poky-iris.conf
```bitbake
# SPDX-License-Identifier: MIT
# Copyright (C) 2021 iris-GmbH infrared & intelligent sensors

require conf/distro/poky.conf

DISTRO_VERSION = "${IRMA6_DISTRO_VERSION}"
DISTRO = "poky-iris"
DISTRO_NAME = "IRIS IRMA6"
unset DISTRO_CODENAME

# enable mdev
VIRTUAL-RUNTIME_dev_manager = "busybox-mdev"
VIRTUAL-RUNTIME_login_manager = "busybox"
VIRTUAL-RUNTIME_initscripts = "initscripts"
VIRTUAL-RUNTIME_keymaps = "keymaps"

# we only want to cherry-pick u-boot and kernel recipes from the adi upstream. ignore everything else
BBMASK += "meta-adi-adsp-sc5xx\/(?!(recipes-bsp\/u-boot)|(recipes-kernel\/linux)|(recipes-kernel\/linux-firmware)).+\/.+"

PACKAGE_CLASSES ?= "package_ipk"
DEPLOY_DIR_IPK = "${TMPDIR}/ipk-deploy"

USER_CLASSES ?= "buildstats image-mklibs image-prelink"

PACKAGECONFIG_append_pn-qemu-native = " sdl"
PACKAGECONFIG_append_pn-nativesdk-qemu = " sdl"

# secure boot settings
HAB_ENABLE ?= "1"
HAB_DIR ?= "${TOPDIR}/../dev_keys"
SRKTAB ?= "${HAB_DIR}/crts/SRK_1_2_3_4_table.bin"
CSFK ?= "${HAB_DIR}/crts/CSF1_1_sha256_secp521r1_v3_usr_crt.pem"
SIGN_CERT ?= "${HAB_DIR}/crts/IMG1_1_sha256_secp521r1_v3_usr_crt.pem"
CRYPTO_HW_ACCEL ?= "CAAM"
BBMASK += "meta-secure-imx/recipes-bsp/u-boot/u-boot_%.bbappend"

# FIXME [RDPHOEN-1177]: This needs to be disabled for security reasons in Rel2
IMAGE_FEATURES += "debug-tweaks"
```

## conf/machine/imx8mp-irma6r2.conf
```bitbake
# SPDX-License-Identifier: MIT
# Copyright (C) 2022 iris-GmbH infrared & intelligent sensors

#@TYPE: Machine
#@NAME: NXP i.MX8MP for iris IRMA6 Release 2
#@SOC: i.MX8MP
#@DESCRIPTION: Machine configuration for iris IRMA6 Release 2 on i.MX8MP

MACHINEOVERRIDES =. "mx8mp:"

require conf/machine/include/imx-base.inc
require conf/machine/include/arm/armv8a/tune-cortexa53.inc

# Mainline BSP defaults to "generic" cortexa53 configuration,
# adjust it here to include crypto extension which enables
# inline NEON and FPU code generation
DEFAULTTUNE:use-mainline-bsp = "cortexa53-crypto"

# Mainline BSP doesn't support DDR4 so it must be set to nxp.
# Also this machine isn't supported by u-boot-fslc but imx8mp-evk.inc already
# set the bootloader to u-boot-imx instead when NXP BSP is used.
IMX_DEFAULT_BSP = "nxp"

# NXP BSP can consume proprietary jailhouse and Marvell drivers
# OP-TEE is also applicable to NXP BSP, mainline BSP seems not to have
# a full support for it yet.
MACHINE_FEATURES:append:use-nxp-bsp = " jailhouse mrvl8997"

KERNEL_DEVICETREE = "freescale/imx8mp-irma6r2.dtb"
KERNEL_DEVICETREE += "freescale/imx8mp-irma6r2-rev3.dtbo"

IMX_DEFAULT_BOOTLOADER:use-nxp-bsp = "u-boot-imx"
IMX_DEFAULT_BOOTLOADER:use-mainline-bsp = "u-boot-fslc"

UBOOT_CONFIG_BASENAME = "imx8mp-irma6r2"

# Set UBoot config for sd (set as default) and mfgtool builds, using the same defconfig
UBOOT_CONFIG ??= "sd"
UBOOT_CONFIG[sd] = "imx8mp_irma6r2_defconfig,sdcard"
UBOOT_CONFIG[mfgtool] = "imx8mp_irma6r2_defconfig"
SPL_BINARY = "spl/u-boot-spl.bin"

ATF_PLATFORM = "imx8mp"

# Set DDR FIRMWARE
DDR_FIRMWARE_VERSION = "202006"
DDR_FIRMWARE_NAME = " \
    ddr4_dmem_1d_${DDR_FIRMWARE_VERSION}.bin \
    ddr4_imem_1d_${DDR_FIRMWARE_VERSION}.bin \
    ddr4_dmem_2d_${DDR_FIRMWARE_VERSION}.bin \
    ddr4_imem_2d_${DDR_FIRMWARE_VERSION}.bin \
"

# Set u-boot DTB
UBOOT_DTB_NAME = "imx8mp-irma6r2.dtb"

# Set imx-mkimage make target
IMXBOOT_TARGETS = "flash_ddr4_evk"

IMX_BOOT_SOC_TARGET = "iMX8MP"

# Set Serial console to UART 3
SERIAL_CONSOLES = "115200;ttymxc2"
ATF_BOOT_UART_BASE = "0x30880000"

LOADADDR = ""
UBOOT_SUFFIX = "bin"
UBOOT_MAKE_TARGET = "all"
IMX_BOOT_SEEK = "32"

OPTEE_BIN_EXT = "8mp"

KERNEL_IMAGETYPE:mx8mp-nxp-bsp = "Image.gz"
KERNEL_MODULE_AUTOLOAD += "powerfail-manager"

# set processor pcb hwrevision for swupdate
HW_VERSION = "6.2"


# FIXME RDPHOEN-1347: Disable loadable module support (CONFIG_MODULE) in linux-fslc's defconfig instead
MODULE_TARBALL_DEPLOY = "0"
```

## conf/machine/imx93-matrix-evk.conf
```bitbake
#@TYPE: Machine
#@NAME: NXP i.MX 93 11x11 EVK with LPDDR4X for Matrix Reloaded
#@SOC: i.MX93

MACHINEOVERRIDES =. "mx93:"

require ../../../meta-freescale/conf/machine/include/imx93-evk.inc

KERNEL_DEVICETREE_BASENAME = "imx93-11x11-evk"
UBOOT_CONFIG_BASENAME = "imx93_11x11_evk"

DDR_FIRMWARE_NAME = " \
    lpddr4_dmem_1d_v202201.bin \
    lpddr4_dmem_2d_v202201.bin \
    lpddr4_imem_1d_v202201.bin \
    lpddr4_imem_2d_v202201.bin \
"

# Override default target flash_singleboot
IMXBOOT_TARGETS = "flash_singleboot_no_ahabfw"

BBMASK  = "imx-atf_2.6"
BBMASK .= "|u-boot-adi|linux-adi"
BBMASK .= "|u-boot-imx-mfgtool|linux-imx-mfgtool"
```

## conf/machine/imx93-matrixup.conf
```bitbake
# SPDX-License-Identifier: MIT
# Copyright (C) 2024 iris-GmbH infrared & intelligent sensors

#@TYPE: Machine
#@NAME: Matrix UP
#@SOC: i.MX93
#@DESCRIPTION: Machine configuration for Matrix UP
#@MAINTAINER: iris-GmbH infrared & intelligent sensors crew

MACHINEOVERRIDES =. "mx93:"

require conf/machine/include/imx-base.inc
require conf/machine/include/arm/armv8-2a/tune-cortexa55.inc

MACHINE_FEATURES += "optee"

KERNEL_DEVICETREE_BASENAME = "imx93-matrixup"

KERNEL_DEVICETREE = "freescale/${KERNEL_DEVICETREE_BASENAME}.dtb"
UBOOT_DTB_NAME = "${KERNEL_DEVICETREE_BASENAME}.dtb"

IMX_DEFAULT_BOOTLOADER = "u-boot-imx"

LOADADDR = ""
UBOOT_SUFFIX = "bin"
UBOOT_MAKE_TARGET = ""
UBOOT_CONFIG_BASENAME = "imx93_matrixup"
SPL_BINARY = "spl/u-boot-spl.bin"
UBOOT_CONFIG = "sd"
UBOOT_CONFIG[sd]   = "${UBOOT_CONFIG_BASENAME}_defconfig,sdcard"

# Set ATF platform name
ATF_PLATFORM = "imx93"

IMXBOOT_TARGETS = "flash_singleboot"

IMX_BOOT_SOC_TARGET = "iMX9"
IMX_BOOT_SEEK = "32"

# We have to disable SERIAL_CONSOLE due to auto-serial-console
SERIAL_CONSOLES = "115200;ttyLP0"

IMX_DEFAULT_BSP = "nxp"

DDR_FIRMWARE_NAME = " \
    lpddr4_dmem_1d_v202201.bin \
    lpddr4_dmem_2d_v202201.bin \
    lpddr4_imem_1d_v202201.bin \
    lpddr4_imem_2d_v202201.bin \
"

KERNEL_IMAGETYPE = "Image.gz"
#KERNEL_MODULE_AUTOLOAD += "powerfail-manager"

# set processor pcb hwrevision for swupdate
HW_VERSION = "5.1"

MODULE_TARBALL_DEPLOY = "0"
```

## conf/machine/include/sc57x.inc
```bitbake
# SPDX-License-Identifier: MIT
# Copyright (C) 2021 iris-GmbH infrared & intelligent sensors

MACHINEOVERRIDES =. "sc57x:"

MACHINE_EXTRA_RRECOMMENDS = " kernel-modules kernel-devicetree"

EXTRA_IMAGEDEPENDS += "u-boot"

include conf/machine/include/arm/armv7a/tune-cortexa5.inc
DEFAULTTUNE="cortexa5thf-neon"

IMAGE_FSTYPES += "tar.bz2 jffs2"
EXTRA_IMAGECMD:jffs2 = "--little-endian --pad=0x0 --pagesize=0x1000 --eraseblock=0x10000 --squash"

SERIAL_CONSOLE = "115200 ttySC0"

PREFERRED_PROVIDER_virtual/kernel ?= "linux-gen6"
PREFERRED_PROVIDER_virtual/bootloader = "u-boot-adi"
PREFERRED_PROVIDER_u-boot = "u-boot-adi"

KERNEL_IMAGETYPE = "uImage-gzip"
KERNEL_IMAGE_SYMLINK = "uImage"
KERNEL_DEVICETREE ?= "sc573-gen6.dtb"
KERNEL_DEVICETREE_SYMLINK = "sc57x-gen6.dtb"
KERNEL_EXTRA_ARGS += "LOADADDR=${UBOOT_ENTRYPOINT}"

OLDEST_KERNEL = "4.14"

UBOOT_SUFFIX = "ldr"
UBOOT_MACHINE ?= "sc573-gen6_defconfig"
UBOOT_ENTRYPOINT = "0x82008000"
UBOOT_LOADADDRESS = "0x82000000"

IMAGE_BOOT_FILES ?= "u-boot.${UBOOT_SUFFIX}"

BOARD ?= "sc573-gen6"
```

## conf/machine/sc572-gen6.conf
```bitbake
# SPDX-License-Identifier: MIT
# Copyright (C) 2021 iris-GmbH infrared & intelligent sensors

#@TYPE: Machine
#@NAME: sc572-gen6

#@DESCRIPTION: Machine configuration for Generation 6 platform with sc572 cpu

require conf/machine/include/sc57x.inc

KERNEL_DEVICETREE = "sc572-gen6.dtb"
UBOOT_MACHINE = "sc572-gen6_defconfig"
BOARD = "sc572-gen6"
```

## conf/machine/sc573-gen6-4dvein.conf
```bitbake
# SPDX-License-Identifier: MIT
# Copyright (C) 2021 iris-GmbH infrared & intelligent sensors

#@TYPE: Machine
#@NAME: sc573-gen6-4dvein

#@DESCRIPTION: Machine configuration for Generation 6 platform with sc573 cpu (4dvein configuration)

require conf/machine/include/sc57x.inc

BOARD = "sc573-gen6-4dvein"
```

## conf/machine/sc573-gen6.conf
```bitbake
# SPDX-License-Identifier: MIT
# Copyright (C) 2021 iris-GmbH infrared & intelligent sensors

#@TYPE: Machine
#@NAME: sc573-gen6

#@DESCRIPTION: Machine configuration for Generation 6 platform with sc573 cpu

require conf/machine/include/sc57x.inc

BOARD = "sc573-gen6"
```
